## meta-ocl-rcar-gen3/conf/layer.conf
```bitbake
# We have a conf and classes directory, add to BBPATH
BBPATH .= ":${LAYERDIR}"

# We have recipes-* directories, add to BBFILES
BBFILES += "${LAYERDIR}/recipes-*/*/*.bb \
    ${LAYERDIR}/recipes-*/*/*.bbappend"

BBFILE_COLLECTIONS += "ocl-rcar-gen3"
BBFILE_PATTERN_ocl-rcar-gen3 = "^${LAYERDIR}/"
BBFILE_PRIORITY_ocl-rcar-gen3 = "7"
```
